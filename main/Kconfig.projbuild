## main/Kconfig.projbuild
```kconfig
menu "Qualia demo"

    choice QUALIA_MODE
        prompt "Operating mode"
        default QUALIA_MODE_DEMO
        help
            USB MIDI and native JTAG tracing cannot share the ESP32-S3
            internal USB PHY. Use a separate configuration for each mode.

        config QUALIA_MODE_DEMO
            bool "Display and buttons"

        config QUALIA_MODE_MIDI
            bool "Display, buttons, and USB MIDI 2.0 with MIDI 1.0 fallback"

        config QUALIA_MODE_TRACE
            bool "Display, buttons, and JTAG application tracing"
    endchoice

    config QUALIA_IMU_DEBUG
        bool "Show raw IMU readings"
        default n
        help
            Logs the LSM6DSOX and LIS3MDL readings, in the sensor frame, over
            serial at 2 Hz and shows them on screen. Used to check the sensor
            axes against the display.

endmenu
```

## sdkconfig.defaults
```kconfig
CONFIG_IDF_TARGET="esp32s3"
CONFIG_ESPTOOLPY_FLASHSIZE_16MB=y
CONFIG_SPIRAM=y
CONFIG_SPIRAM_MODE_OCT=y
CONFIG_SPIRAM_SPEED_80M=y
CONFIG_SPIRAM_XIP_FROM_PSRAM=y
CONFIG_PARTITION_TABLE_CUSTOM=y
CONFIG_PARTITION_TABLE_CUSTOM_FILENAME="partitions.csv"
CONFIG_FREERTOS_HZ=1000
CONFIG_ESP_CONSOLE_USB_SERIAL_JTAG=y
CONFIG_ESP_CONSOLE_SECONDARY_NONE=y
CONFIG_LV_CONF_SKIP=y
CONFIG_LV_COLOR_DEPTH_16=y
CONFIG_LV_USE_BUILTIN_MALLOC=y
CONFIG_LV_MEM_SIZE=65536
CONFIG_LV_DEF_REFR_PERIOD=16
CONFIG_LV_DPI_DEF=340
CONFIG_LV_OS_NONE=y
CONFIG_LV_USE_DRAW_SW=y
CONFIG_LV_DRAW_SW_SUPPORT_RGB565=y
CONFIG_LV_DRAW_SW_SUPPORT_ARGB8888=y
CONFIG_LV_USE_CANVAS=y
CONFIG_LV_DRAW_SW_COMPLEX=y
CONFIG_TINYUSB_MIDI_COUNT=0
CONFIG_COMPILER_OPTIMIZATION_PERF=y
CONFIG_ESP_DEFAULT_CPU_FREQ_MHZ_240=y
CONFIG_ESPTOOLPY_FLASHMODE_QIO=y
```

## sdkconfig.defaults.midi
```kconfig
CONFIG_QUALIA_MODE_MIDI=y
CONFIG_TINYUSB_MIDI_COUNT=0
CONFIG_TINYUSB_SUSPEND_CALLBACK=y
CONFIG_TINYUSB_RESUME_CALLBACK=y
CONFIG_ESP_CONSOLE_UART_DEFAULT=y
# CONFIG_ESP_CONSOLE_USB_SERIAL_JTAG is not set
# CONFIG_ESP_CONSOLE_SECONDARY_USB_SERIAL_JTAG is not set
```

## sdkconfig.defaults.perf
```kconfig
CONFIG_LV_USE_LOG=y
CONFIG_LV_LOG_LEVEL_WARN=y
CONFIG_LV_LOG_PRINTF=y
CONFIG_LV_USE_SYSMON=y
CONFIG_LV_USE_PERF_MONITOR=y
CONFIG_LV_USE_PERF_MONITOR_LOG_MODE=y
```
